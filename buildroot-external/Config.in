## buildroot-external/Config.in
```kconfig
comment "Author: Austinsuyoyo"

menu "EtherCAT application"
source "$BR2_EXTERNAL_RTRPI_PATH/package/igh/Config.in"
endmenu
```

## buildroot-external/configs/rpi3_5.4_defconfig
```kconfig
# Target options
BR2_arm=y
BR2_cortex_a53=y
BR2_ARM_FPU_NEON_VFPV4=y

# Build options
BR2_GLOBAL_PATCH_DIR="$(BR2_EXTERNAL_RTRPI_PATH)/patches"
BR2_CCACHE=y

# Toolchain
BR2_TOOLCHAIN_BUILDROOT_GLIBC=y
BR2_TOOLCHAIN_BUILDROOT_CXX=y
BR2_TOOLCHAIN_BUILDROOT_WCHAR=y
BR2_PACKAGE_HOST_LINUX_HEADERS_CUSTOM_5_4=y

# System configuration
BR2_SYSTEM_DHCP="eth0"
BR2_TARGET_GENERIC_ROOT_PASSWD="root"
BR2_ROOTFS_POST_BUILD_SCRIPT="$(BR2_EXTERNAL_RTRPI_PATH)/board/rpi3/post-build.sh"
BR2_ROOTFS_POST_IMAGE_SCRIPT="$(BR2_EXTERNAL_RTRPI_PATH)/board/rpi3/post-image.sh"

# Kernel 
BR2_LINUX_KERNEL=y
BR2_LINUX_KERNEL_CUSTOM_TARBALL=y
BR2_LINUX_KERNEL_USE_CUSTOM_CONFIG=y
BR2_LINUX_KERNEL_CUSTOM_CONFIG_FILE="$(BR2_EXTERNAL_RTRPI_PATH)/board/rpi3/xenomai-rpi3.config"
BR2_LINUX_KERNEL_CUSTOM_TARBALL_LOCATION="$(call github,raspberrypi,linux,ec0dcf3064b8ba99f226438214407fcea9870f76)/linux-ec0dcf3064b8ba99f226438214407fcea9870f76.tar.gz"
BR2_LINUX_KERNEL_DEFCONFIG="bcm2709"
BR2_LINUX_KERNEL_DTS_SUPPORT=y
BR2_LINUX_KERNEL_INTREE_DTS_NAME="bcm2710-rpi-3-b bcm2710-rpi-3-b-plus bcm2710-rpi-cm3"
BR2_LINUX_KERNEL_NEEDS_HOST_OPENSSL=y

# Xenomai Setup
BR2_LINUX_KERNEL_EXT_XENOMAI=y
BR2_LINUX_KERNEL_EXT_XENOMAI_ADEOS_PATCH="$(BR2_EXTERNAL_RTRPI_PATH)/ipipe/unofficial-ipipe-core-5.4.93-arm-0.patch"
BR2_PACKAGE_XENOMAI_GITLAB=y
BR2_PACKAGE_XENOMAI_VERSION="v3.2.1"
BR2_PACKAGE_XENOMAI_TESTSUITE=y

# RPI firmware data
BR2_PACKAGE_RPI_FIRMWARE=y
BR2_PACKAGE_RPI_FIRMWARE_BOOTCODE_BIN=y
BR2_PACKAGE_RPI_FIRMWARE_VARIANT_PI=y
BR2_PACKAGE_RPI_FIRMWARE_CONFIG_FILE="$(BR2_EXTERNAL_RTRPI_PATH)/board/rpi3/config-rpi3.txt"

# Required tools to create the SD image
BR2_PACKAGE_HOST_DOSFSTOOLS=y
BR2_PACKAGE_HOST_GENIMAGE=y
BR2_PACKAGE_HOST_MTOOLS=y

# Filesystem images
BR2_TARGET_ROOTFS_EXT2=y
BR2_TARGET_ROOTFS_EXT2_4=y
BR2_TARGET_ROOTFS_EXT2_SIZE="120M"

# Target Package
BR2_PACKAGE_BUSYBOX_SHOW_OTHERS=y
BR2_PACKAGE_DHCP=y
BR2_PACKAGE_DHCP_CLIENT=y
BR2_PACKAGE_BASH=y
BR2_SYSTEM_BIN_SH_BASH=y
BR2_PACKAGE_NEOFETCH=y
BR2_PACKAGE_OPENSSH=y
BR2_PACKAGE_OPENSSH_SERVER=y
BR2_PACKAGE_NANO=y
```

## buildroot-external/configs/rpi3_64_4.19_defconfig
```kconfig
# Target options
BR2_aarch64=y
BR2_cortex_a53=y
BR2_ARM_FPU_VFPV4=y

# Build options
BR2_GLOBAL_PATCH_DIR="$(BR2_EXTERNAL_RTRPI_PATH)/patches"
BR2_CCACHE=y

# Toolchain
BR2_TOOLCHAIN_BUILDROOT_CXX=y
BR2_TOOLCHAIN_BUILDROOT_WCHAR=y
BR2_PACKAGE_HOST_LINUX_HEADERS_CUSTOM_4_19=y

# System configuration
BR2_SYSTEM_DHCP="eth0"
BR2_TARGET_GENERIC_ROOT_PASSWD="root"
BR2_ROOTFS_POST_BUILD_SCRIPT="$(BR2_EXTERNAL_RTRPI_PATH)/board/rpi3-64/post-build.sh"
BR2_ROOTFS_POST_IMAGE_SCRIPT="$(BR2_EXTERNAL_RTRPI_PATH)/board/rpi3-64/post-image.sh"

# Kernel 
BR2_LINUX_KERNEL=y
BR2_LINUX_KERNEL_CUSTOM_TARBALL=y
BR2_LINUX_KERNEL_USE_CUSTOM_CONFIG=y
BR2_LINUX_KERNEL_CUSTOM_CONFIG_FILE="$(BR2_EXTERNAL_RTRPI_PATH)/board/rpi3-64/xenomai-rpi3-64.config"
BR2_LINUX_KERNEL_CUSTOM_TARBALL_LOCATION="$(call github,raspberrypi,linux,bfef951a177d4d3f10e8b5072316a517d68a2a27)/linux-bfef951a177d4d3f10e8b5072316a517d68a2a27.tar.gz"
BR2_LINUX_KERNEL_DEFCONFIG="bcmrpi3"
BR2_LINUX_KERNEL_DTS_SUPPORT=y
BR2_LINUX_KERNEL_INTREE_DTS_NAME="broadcom/bcm2710-rpi-3-b broadcom/bcm2710-rpi-3-b-plus broadcom/bcm2837-rpi-3-b"
BR2_LINUX_KERNEL_NEEDS_HOST_OPENSSL=y

# Xenomai Setup
BR2_LINUX_KERNEL_EXT_XENOMAI=y
BR2_LINUX_KERNEL_EXT_XENOMAI_ADEOS_PATCH="$(BR2_EXTERNAL_RTRPI_PATH)/ipipe/unofficial-ipipe-core-4.19.144-arm64-7.patch"
BR2_PACKAGE_XENOMAI_CUSTOM_VERSION=y
BR2_PACKAGE_XENOMAI_VERSION="3.1"
BR2_PACKAGE_XENOMAI_TESTSUITE=y

# RPI firmware data
BR2_PACKAGE_RPI_FIRMWARE=y
BR2_PACKAGE_RPI_FIRMWARE_BOOTCODE_BIN=y
BR2_PACKAGE_RPI_FIRMWARE_VARIANT_PI=y
BR2_PACKAGE_RPI_FIRMWARE_CONFIG_FILE="$(BR2_EXTERNAL_RTRPI_PATH)/board/rpi3-64/config-rpi3-64bit.txt"

# Required tools to create the SD image
BR2_PACKAGE_HOST_DOSFSTOOLS=y
BR2_PACKAGE_HOST_GENIMAGE=y
BR2_PACKAGE_HOST_MTOOLS=y

# Filesystem images
BR2_TARGET_ROOTFS_EXT2=y
BR2_TARGET_ROOTFS_EXT2_4=y
BR2_TARGET_ROOTFS_EXT2_SIZE="120M"

# Target Package
BR2_PACKAGE_BUSYBOX_SHOW_OTHERS=y
BR2_PACKAGE_DHCP=y
BR2_PACKAGE_DHCP_CLIENT=y
BR2_PACKAGE_BASH=y
BR2_SYSTEM_BIN_SH_BASH=y
BR2_PACKAGE_NEOFETCH=y
BR2_PACKAGE_OPENSSH=y
BR2_PACKAGE_OPENSSH_SERVER=y
BR2_PACKAGE_NANO=y
```

## buildroot-external/package/igh/Config.in
```kconfig
comment "igh-ethercat needs a Linux kernel to be built"
	depends on !BR2_LINUX_KERNEL

config BR2_PACKAGE_IGH
	bool "igh"
	depends on BR2_LINUX_KERNEL
	help
	  IgH EtherCAT Master for Linux.

	  https://gitlab.com/etherlab.org/ethercat

if BR2_PACKAGE_IGH

config BR2_PACKAGE_IGH_8139TOO
	bool "8139too driver"

config BR2_PACKAGE_IGH_E100
	bool "e100 driver"

config BR2_PACKAGE_IGH_E1000
	bool "e1000 driver"

config BR2_PACKAGE_IGH_E1000E
	bool "e1000e driver"

config BR2_PACKAGE_IGH_R8169
	bool "r8169 driver"

endif
```
